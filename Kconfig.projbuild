## Kconfig.projbuild
```kconfig
menu "ESP32-C3 Bare Metal Configuration"

    config BLINK_GPIO
        int "Blink GPIO number"
        range 0 21
        default 8
        help
            GPIO number (IOxx) to blink on and off.
            Some GPIOs are used for other purposes (flash connections, etc.) and cannot be used to blink.
            GPIOs 0-21 are valid.

endmenu
```
